## meta-append-layer/conf/layer.conf
```bitbake
# We have a conf and classes directory, add to BBPATH
BBPATH .= ":${LAYERDIR}"

# We have recipes-* directories, add to BBFILES
BBFILES += "${LAYERDIR}/recipes-*/*/*.bb \
            ${LAYERDIR}/recipes-*/*/*.bbappend"

BBFILE_COLLECTIONS += "meta-append-layer"
BBFILE_PATTERN_meta-append-layer = "^${LAYERDIR}/"
BBFILE_PRIORITY_meta-append-layer = "6"

LAYERDEPENDS_meta-append-layer = "core"
LAYERSERIES_COMPAT_meta-append-layer = "kirkstone"
```
